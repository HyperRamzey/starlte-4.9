## drivers/fingerprint/Kconfig
```kconfig
#
# Sensor  drivers configuration
#
menuconfig SENSORS_FINGERPRINT
	bool "Finger Print Sensor devices"
	help
	  Say Y here, and a list of sensors drivers will be displayed.
	  Everything that didn't fit into the other categories is here. This option
	  doesn't affect the kernel.
	  If unsure, say Y.

config SENSORS_FPRINT_SECURE
	tristate "fingerprint sensor support"
	default n
	help
	  If you say yes here you get support for Trustzone.
	  In case of user binary, fingerprint sensor operates within trustzone.
	  If this feature enabled, spi communication is controlled by Trusted Application.
	  Then it should be enabled in the user binary.

config SENSORS_FINGERPRINT_32BITS_PLATFORM_ONLY
	tristate "Fingerprint sensor supports only 32bits platform"
	default n
	help
	  If you say yes here the non TZ device driver will only supports
	  32bits platform.
	  In case of Exynos7580, this feature should be enabled.
	  And you should be use the compat_ioctl not the unlocked_ioctl.

config SENSORS_VFS7XXX
	tristate "VFS7XXX fingerprint sensor support"
	default n
	help
	  Fingerprint sensor driver.
	  If you say yes here you get support for viper2 sensor.
	  Viper2 is the touch type fingerprint sensor.
	  Viper2 82E5 module can support WOG mode.

config SENSORS_VFS8XXX
	tristate "VFS8XXX fingerprint sensor support"
	default n
	help
	  Fingerprint sensor driver.
	  If you say yes here you get support for Namsan sensor.
	  Namsan is the touch type fingerprint sensor.
	  Namsan module can support WOF mode.

config SENSORS_ET5XX
	tristate "ET5XX fingerprint sensor supprot"
	default n
	help
	  Fingerprint sensor driver.
	  If you say yes here you get support for ET5XX sensor.
	  ET5XX is the touch type fingerprint sensor.
	  ET5XX module can support WOF mode.

config SENSORS_ET7XX
	stristate "ET7XX fingerprint sensor support"
	default n
	help
	  If you say yes here you get support for Egistec's
	  fingerprint sensor ET7XX.  This is the symbol name the stock
	  exynos7885 A30s kernel config uses, so it must stay spelled
	  exactly this way or the stock config stops resolving.
	
	  ET7XX is Egistec's optical under-display sensor family
	  (ET711A / ET713A / ET715).  The driver binds to the DT
	  compatible string "etspi,et7xx" and probes as an SPI device.
	  The A30s carries an ET715.
	
	  This symbol is MUTUALLY EXCLUSIVE with SENSORS_ET5XX above.
	  Both build objects that export the SAME global symbols --
	  etspi_Interrupt_Init, etspi_Interrupt_Free, etspi_Interrupt_Abort,
	  etspi_fps_interrupt_poll, etspi_platformInit, etspi_platformUninit
	  and fpsensor_goto_suspend -- and both link built-in into vmlinux,
	  so enabling the two together is a duplicate-definition link
	  failure, not a runtime conflict.  There is deliberately no
	  depends on / select between them: kconfig would then silently drop
	  one of the two symbols, which is the failure mode that hides
	  itself.  Keep the pairing explicit in the defconfig instead.  The
	  correct pairing for this board, and the one the stock config uses,
	  is SENSORS_ET7XX=y with SENSORS_ET5XX unset.
	
	  Coexists freely with SENSORS_VFS7XXX and SENSORS_VFS8XXX: those
	  use a vfsspi_ symbol prefix and claim no overlapping global.
	  VFS7XXX has no object at all in this tree, and VFS8XXX is the
	  9810-era Namsan part, which is not what this die carries.
```

## drivers/muic/Kconfig
```kconfig
#
# MUIC devices
#

comment "MUIC configs"

config USE_MUIC
	bool "Using MUIC device driver"
	depends on I2C
	default n
	help
	  If you say yes here you will get support for
	  the MUIC device driver.

config USE_SAFEOUT
	bool "Using SAFEOUT device driver"
	depends on I2C
	default n
	help
	  If you say yes here you will get support for
	  the SAFEOUT device driver.

config MUIC_NOTIFIER
	bool "MUIC notifier support"
	depends on USE_MUIC
	default n
	help
	  If you say yes here you will get support for
	  the MUIC attached device status change notification.

config MUIC_MAX77705
        bool "Using MAX77705 MUIC"
        depends on USE_MUIC
        default n
        help
          If you say yes here you will get support for
          the MAX77705 MUIC chip.
	  To enable this driver,
	  USE_MUIC should be enabled.

config HV_MUIC_MAX77705_AFC
        bool "Using MAX77705 AFC MUIC"
        depends on MUIC_MAX77705
        default n
        help
          If you say yes here you will get support for
	  the MAX77705 AFC MUIC.
	  To enable this driver,
	  MUIC_MAX77705 should be enabled.

config MUIC_UNIVERSAL
	bool "UNIVERSAL MUIC"
	depends on USE_MUIC
	default n
	help
	  If you say yes here you will get support for various MUIC chips.

config MUIC_UNIVERSAL_MAX77854
	bool "MAX77854 MUIC"
	depends on MUIC_UNIVERSAL
	default n
	help
	  If you say yes here you will get support for the MAX77854 MUIC chip.

config MUIC_UNIVERSAL_MAX77865
	bool "MAX77865 MUIC"
	depends on MUIC_UNIVERSAL
	default n
	help
	  If you say yes here you will get support for the MAX77865 MUIC chip.

config MUIC_HV
	bool "MUIC_HV"
	depends on USE_MUIC
	default n
	help
	  If you say yes here you will get support for the AFC.
	  DERP PORT NOTE: 4.4 exynos7885 says "depends on USE_MUIC"
	  here. The 4.9 max77865 generation narrowed it to MUIC_UNIVERSAL,
	  which makes the symbol unreachable for the S2MU106 AFC path --
	  HV_MUIC_S2MU106_AFC below needs MUIC_HV. Widening it back to
	  USE_MUIC changes no 4.9 resolution: every configuration that
	  resolved MUIC_HV=y already had MUIC_UNIVERSAL=y, and
	  MUIC_UNIVERSAL still depends on USE_MUIC, so the new condition
	  is strictly weaker than the old one.

config MUIC_HV_12V
	bool "MUIC_HV_12V"
	depends on MUIC_HV
	default n
	help
	  If you say yes here you will get support for the AFC.

config MUIC_HV_MAX77854
	bool "MUIC_HV_MAX77854"
	depends on MUIC_UNIVERSAL_MAX77854
	default n
	help
	  If you say yes here you will get support for the AFC.

config MUIC_HV_MAX77865
	bool "MUIC_HV_MAX77865"
	depends on MUIC_UNIVERSAL_MAX77865
	default n
	help
	  If you say yes here you will get support for the AFC.

config MUIC_SUPPORT_CCIC
	bool "MUIC supports CCIC chip interface"
	default n
	help
	  If you say yes here you will get support for the CCIC chip.

config MUIC_MAX77705_CCIC
        bool "Using MAX77705 MUIC supports CCIC chip interface"
        depends on MUIC_MAX77705 && MUIC_SUPPORT_CCIC
        default n
        help
          If you say yes here you will get support for
	  the CCIC chip with MAX77705 MUIC.
	  To enable this driver,
	  MUIC_MAX77705 and MUIC_SUPPORT_CCIC should be enabled.

config MUIC_TEST_FUNC
	bool "MUIC supports several function's in TEST"
	depends on SEC_DEBUG && !SAMSUNG_PRODUCT_SHIP
	default n
	help
	  If you say yes here you will get support for the TEST function's.

config HICCUP_CHARGER
	bool "Using HICCUP charger"
	depends on USE_MUIC && !SEC_FACTORY
	default n
	help
		If you say yes here you will get support for
		for the hiccup charger feature.

config MUIC_HV_SUPPORT_POGO_DOCK
	bool "MUIC_HV_SUPPORT_POGO_DOCK"
	depends on USE_MUIC
	default n
	help
	  If you say yes here you will get support for the AFC pogo dock.

config MUIC_SM5508
	bool "SM5508 MUIC"
	depends on USE_MUIC
	default n
	help
	  If you say yes here you will get support for the SM5508 MUIC chip.
	  


# ---------------------------------------------------------------------------
# DERP PORT: the Samsung S2MU106 MUIC generation (4.4 exynos7885, Galaxy A30s)
# ---------------------------------------------------------------------------
#
# The 4.9 base (starlte, exynos9810) forked before Samsung's Type-C S2MU106
# MUIC existed; it ships the max77705 / MUIC_UNIVERSAL generation instead.
# drivers/muic/{muic_core,muic_manager,s2mu106-muic,s2mu106-muic-afc}.c have
# been ported from 4.4 but had no Kconfig to switch them on, so all four were
# orphans: no Makefile rule reached any of them and none of the 4.4-only
# symbols existed.
#
# MUTUAL EXCLUSION IS LOAD-BEARING, NOT COSMETIC. The two generations export
# the same global names, so linking both is a hard duplicate-symbol failure.
# Measured without a compiler, definition sites only:
#
#   get_switch_sel              muic-core.c:382   vs muic_core.c:244
#   get_afc_mode                muic-core.c:403   vs muic_core.c:266
#   get_ccic_info               muic-core.c:426   vs muic_manager.c:139
#   muic_send_dock_intent       muic-core.c:75    vs muic_core.c:77
#   muic_afc_set_voltage        muic-core.c:493   vs s2mu106-muic-afc.c:723
#
# The depends-on lines below make the impossible combination unresolvable in
# Kconfig instead of letting it reach the linker. Turning MUIC_MAX77705 and
# MUIC_UNIVERSAL off is independently the right configuration for this board:
# the real A307FN device tree contains no MAX77xxx node anywhere (see
# hm_mod/port49_evidence/stockfw/STOCKFW_FINDINGS.md 3.3), and the stock
# 4.4.177 config has MUIC_S2MU106 = y with no MAX77705 = y at all.

config MUIC_CORE
	bool "Supports MUIC Core (S2MU106 generation)"
	depends on USE_MUIC
	default n
	help
	  4.4's name for drivers/muic/muic_core.c, the S2MU106 MUIC core
	  layer. Do not confuse it with the max77705-generation
	  drivers/muic/muic-core.c, which is a different file and is gated
	  on the legacy chips in drivers/muic/Makefile.

config MUIC_MANAGER
	bool "MUIC Manager supports CCIC chip interface"
	depends on USE_MUIC && MUIC_CORE
	default n
	help
	  Builds drivers/muic/muic_manager.c. This is the layer that turns a
	  muic_attached_dev_t into a power-supply property and routes RID
	  opens. 18 muic_manager_* symbols are present in the live 4.4 A30s
	  kallsyms, so it is not dead scaffolding.

config MUIC_S2MU106
	bool "Using S2MU106 MUIC"
	depends on USE_MUIC && MFD_S2MU106
	depends on !MUIC_MAX77705 && !MUIC_UNIVERSAL
	default n
	help
	  If you say yes here you will get support for the S2MU106 MUIC chip.
	  4.4 gates this on USE_MUIC && MFD_S2MU106. The second depends-on
	  line is the DERP port's mutual exclusion with the max77705 /
	  MUIC_UNIVERSAL generation, which cannot be linked alongside it;
	  see the note above this block.

config HV_MUIC_S2MU106_AFC
	bool "Using S2MU106 MUIC AFC"
	depends on MUIC_HV && MUIC_S2MU106
	default n
	help
	  If you say yes here you will get support for the AFC.

config MUIC_S2MU106_RID
	bool "Using S2MU106 MUIC RID"
	depends on MUIC_S2MU106
	default n
	help
	  If you say yes here you will get support for the S2MU106 MUIC RID
	  functions.

config MUIC_SUPPORT_POWERMETER
	bool "MUIC supports PM chip interface"
	depends on USE_MUIC
	default n
	help
	  If you say yes here you will get support for the Power Meter.
	  A pure #ifdef feature in 4.4: no Makefile rule, no extra object.
	  Under it s2mu106-usbpd.c reads POWER_SUPPLY_PROP_VCC1 / _VCC2 and
	  the CHGIN voltage from the PM_S2MU106 power meter.

config MUIC_SUPPORT_PRSWAP
	bool "MUIC supports power role swap"
	depends on USE_MUIC
	default n
	help
	  If you say yes here you will get support for the power role swap.
	  A pure #ifdef feature in 4.4: no Makefile rule, no extra object.

# The next two come from 4.4's drivers/muic/Kconfig, which this tree's version
# lacks because 4.9's muic Kconfig is the max77705 generation's.

config MUIC_SYSFS
	bool "Using muic sysfs Features"
	depends on USE_MUIC
	default n
	help
	  If you say yes here you will get support for the muic sysfs.
	  Builds drivers/muic/muic_sysfs.c, the S2MU106 generation's sysfs
	  attribute group (uart_sel, usb_sel, adc, mansw, dump_registers,
	  int_status, usb_state, otg_test, attached_dev, audio_path,
	  apo_factory, usb_en, vbus_value, afc_disable, afc_set_voltage,
	  hiccup). It is distinct from universal/muic_sysfs.o, which belongs
	  to the MUIC_UNIVERSAL generation and is a different file with
	  different attributes; the two never land in the same build because
	  MUIC_S2MU106 excludes MUIC_UNIVERSAL, and in any case their only
	  shared symbol names (muic_show_vbus_value, muic_store_afc_set_
	  voltage) are "static" in both files. The stock config sets
	  CONFIG_MUIC_SYSFS=y.

config HV_MUIC_VOLTAGE_CTRL
	bool "Using AFC Voltage control functionality"
	depends on MUIC_HV
	default n
	help
	  If you say yes here you will get support for
	  the AFC voltage control functionality.
	  4.4 spells the dependency "MUIC_HV_S2MU004_AFC || MUIC_HV". Only the
	  MUIC_HV disjunct is kept: MUIC_HV_S2MU004_AFC is a 4.4 symbol for a
	  chip this port does not build, and naming an undefined symbol in a
	  depends-on is a no-op, so keeping it would only be misleading.
	  Read by drivers/muic/muic_sysfs.c at lines 491, 579 and 609, gating
	  the afc_disable, vbus_value and afc_set_voltage attributes. The stock
	  config sets CONFIG_HV_MUIC_VOLTAGE_CTRL=y. AFC on this phone is
	  5 V and 9 V only, so MUIC_HV_12V stays n: 12 V on the A30s comes from
	  Type-C PD, whose accept ceiling is MAX_CHARGING_VOLT = 12000 mV in
	  include/linux/ccic/usbpd.h.
```

## drivers/p49debug/Kconfig
```kconfig
# TEMPORARY bring-up instrumentation. Delete this whole directory once the
# 4.9 port's boot hang is found -- see drivers/p49debug/p49-bootbeacon.c.
config P49_BOOTBEACON
	bool "4.9 port boot beacon (TEMPORARY, panics on purpose)"
	depends on DEBUG_KERNEL || !EXPERT
	help
	  TEMPORARY. This kernel has never booted and there is no console
	  available (no serial cable, CONFIG_VT off so no framebuffer console,
	  and the bootloader's "ecd_setup=disable" turns Samsung's ECD off after
	  CONFIG_CMDLINE is applied, so it cannot be overridden). A hang is
	  therefore completely invisible.

	  Enabling this makes the kernel panic deliberately at the end of
	  device probing, so that the pstore ramoops backend records the log up to
	  that point. Read it afterwards with:

	    adb pull /sys/fs/pstore/dmesg-ramoops-0

	  It is paired with turning CONFIG_PSTORE_CONSOLE off, because with pmsg
	  writing continuously into the same buffer there is no room left for the
	  panic-time dmesg record -- which is why no dmesg-ramoops record has ever
	  appeared despite the kernel plainly dying.

	  If unsure, say N. This must not survive into a shipping kernel.

config P49_BOOTBEACON_MS
	int "Boot beacon delay in ms"
	depends on P49_BOOTBEACON
	default 10000
	help
	  How long after late_initcall the beacon waits before panicking. Raise it
	  to let more of boot complete before the panic; lower it toward 0 to
	  bisect an early hang. Moving the beacon's initcall level is a code
	  change; this only moves the deadline.
```

## drivers/video/fbdev/exynos/dpu_7885/panels/Kconfig
```kconfig
config EXYNOS_DECON_LCD
	depends on EXYNOS_DECON_7885
	bool "Select LCD panel driver"

config DISPLAY_USE_INFO
	tristate "Support display use info logging"
	default n

config EXYNOS_DECON_MDNIE
	tristate "Support MDNIE"
	default n

config EXYNOS_DECON_MDNIE_LITE
	depends on EXYNOS_DECON_MDNIE
	tristate "Support backward compatibility for MDNIE"
	default y

config EXYNOS_DECON_MDNIE_CONTROL
	bool "Samsung Exynos7885 Display colour controller"
	default n

config SUPPORT_POC_FLASH
	depends on EXYNOS_DECON_LCD
	tristate "Support display poc flash"
	default n

config CUSTOM_BACKLIGHT_SYSFS_NODE
	bool "Custom sysfs node for backlight"
	depends on EXYNOS_DECON_LCD_S6E8FC1_A30S
	default n
	help
	  If you say yes here, you will get support for a custom backlight sysfs node.

# The A30s panel. Live running.config:2924 CONFIG_EXYNOS_DECON_LCD_S6E8FC1_A30S=y,
# and every other EXYNOS_DECON_LCD_* panel there is "not set".
config EXYNOS_DECON_LCD_S6E8FC1_A30S
	bool "S6E8FC1_A30S LCD driver"
	depends on EXYNOS_DECON_LCD && EXYNOS_MIPI_DSIM
```
